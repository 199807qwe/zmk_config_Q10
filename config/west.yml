## config/west.yml
```yaml
manifest:
  remotes:
    - name: zmkfirmware
      url-base: https://github.com/zmkfirmware
#    - name: ZitaoTech
#      url-base: https://github.com/ZitaoTech
    - name: 199807qwe
      url-base: https://github.com/199807qwe
  projects:
    - name: zmk
      remote: 199807qwe
      revision: bbkeyboard_tp
      import: app/west.yml
  self:
    path: config
```
